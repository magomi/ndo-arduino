#include <PCM.h>

const unsigned char nein[] PROGMEM = {
126, 126, 126, 126, 126, 126, 126, 126, 126, 126, 126, 126,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 128, 
};


const unsigned char doch[] PROGMEM = {
129, 129, 127, 126, 126, 127, 129, 130, 129, 128, 127, 127,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 127, 
};

const unsigned char ohhh[] PROGMEM = {
126, 126, 127, 127, 127, 126, 126, 126, 127, 128, 129, 128,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 128, 
};

const int actionLedPin = 13;

const int neinPin = 7;
const int dochPin = 6;
const int ohhhPin = 5;

int neinState = 0;
int dochState = 0;
int ohhhState = 0;
int serialReceived = 0;

void setup()
{
  Serial.begin(9600);
  pinMode(neinPin, INPUT);
  pinMode(dochPin, INPUT);
  pinMode(ohhhPin, INPUT);
  pinMode(actionLedPin, OUTPUT);
}

void loop()
{

  if (Serial.available() > 0) {
    serialReceived = Serial.read();
  }
  
  if (!Serial.available()) {
    neinState = digitalRead(neinPin);
    dochState = digitalRead(dochPin);
    ohhhState = digitalRead(ohhhPin);
  
    if (neinState == HIGH || serialReceived == 'n') {
      digitalWrite(actionLedPin, HIGH);
      startPlayback(nein, sizeof(nein));
      delay(340);
      digitalWrite(actionLedPin, LOW);
    }
  
    if (dochState == HIGH || serialReceived == 'd') {
      digitalWrite(actionLedPin, HIGH);
      startPlayback(doch, sizeof(doch));
      delay(220);
      digitalWrite(actionLedPin, LOW);
    }

    if (ohhhState == HIGH || serialReceived == 'o') {
      digitalWrite(actionLedPin, HIGH);
      startPlayback(ohhh, sizeof(ohhh));
      delay(600);
      digitalWrite(actionLedPin, LOW);
    }
  
    serialReceived = 0;
  }

  delay(50);
}


